// SPDX-License-Identifier: (GPL-2.0+ OR MIT)
/*
 * Elegoo ZNP-K1 V2.3 printer controller, Neptune 4 Plus / Max with the USB-C
 * toolhead (CDC-ACM Klipper MCU on the toolhead board).
 *
 * The OpenNept4une Neptune4-Plus+Max USB-C image boots this board description.
 * Board reverse engineered by ggggcodes; PMIC interrupt fix and hardware
 * testing by dalgibbard.
 */

#include "rk3328-znp-k1-v2x.dts"

/ {
	model = "Elegoo ZNP-K1 V2.3";
};

/*
 * GPIO2_C2 (SoC GPIO 82) switches toolhead power. It is deliberately not
 * hogged: OpenNept4une drives it from userspace and power-cycles it to put
 * the toolhead into its bootloader for flashing.
 */
&gpio2 {
	gpio-line-names =
		/* A0-A7 */ "", "", "", "", "", "", "", "",
		/* B0-B7 */ "", "", "", "", "", "", "", "",
		/* C0-C2 */ "", "", "toolhead-power";
};

/*
 * PMIC interrupt is GPIO2_A6, matching its pmic-int-l pinctrl. The GPIO1_D0
 * mapping inherited from the V2.0 tree leaves the line unserviced on this
 * board (100,001 unhandled IRQs, measured on a V2.3).
 */
&rk805 {
	interrupt-parent = <&gpio2>;
	interrupts = <RK_PA6 IRQ_TYPE_LEVEL_LOW>;
};
